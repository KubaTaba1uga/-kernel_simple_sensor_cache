/dts-v1/;
/plugin/;

/ {
    fragment@0 {
        target = <&rp1_gpio>;
        __overlay__ {
            simple_sensor_cache_device {
                compatible = "raspberrypi,5-model-b";
                data-gpios = <&rp1_gpio 15 0>;
            };
        };
    };
};
